#include <behaviors.dtsi>
#include <dt-bindings/zmk/outputs.h>

#include <dt-bindings/zmk/keys.h>
#include <dt-bindings/zmk/ext_power.h>
#include <dt-bindings/zmk/bt.h>
#include <dt-bindings/zmk/rgb.h>
#include <dt-bindings/zmk/outputs.h>

#include "./zmk-nodefree-config/helper.h"
#include "./zmk-nodefree-config/keypos_def/keypos_glv80.h"

#include "./mouse.dtsi"

#define LEFT_HAND_KEYS   LC5 LC4 LC3 LC2 LC1 \
                         LN5 LN4 LN3 LN2 LN1 LN0 \
                         LT5 LT4 LT3 LT2 LT1 LT0 \
                         LM5 LM4 LM3 LM2 LM1 LM0 \
                         LB5 LB4 LB3 LB2 LB1 LB0 \
                         LF5 LF4 LF3 LF2 LF1

#define RIGHT_HAND_KEYS      RC1 RC2 RC3 RC4 RC5 \
                         RN0 RN1 RN2 RN3 RN4 RN5 \
                         RT0 RT1 RT2 RT3 RT4 RT5 \
                         RM0 RM1 RM2 RM3 RM4 RM5 \
                         RB0 RB1 RB2 RB3 RB4 RB5 \
                             RF1 RF2 RF3 RF4 RF5

#define THUMB_KEYS       LH5 LH4 LH3     RH3 RH4 RH5 \
                         LH2 LH1 LH0     RH0 RH1 RH2

#define UNSET_TIMER  (-1)

#define ALPHA  A B C D E F G H I J K L M N O P \
               Q R S T U V W X Y Z

#define NUMERIC  N0 N1 N2 N3 N4 N5 N6 N7 N8 N9

#define MAKE_HRMS(name, hold_tap_flavor, ...) \
    ZMK_BEHAVIOR(hml_ ## name, hold_tap, \
        flavor = hold_tap_flavor; \
        bindings = <&kp>, <&kp>; \
        hold-trigger-key-positions = <RIGHT_HAND_KEYS THUMB_KEYS>; \
        __VA_ARGS__ \
    ) \
    ZMK_BEHAVIOR(hmr_ ## name, hold_tap, \
        flavor = hold_tap_flavor; \
        bindings = <&kp>, <&kp>; \
        hold-trigger-key-positions = <LEFT_HAND_KEYS THUMB_KEYS>; \
        __VA_ARGS__ \
    )


&sk {  // sticky-key config
    quick-release;
};

&caps_word {  // caps word config, requires PR #1742
    no-default-keys;
    continue-list = <ALPHA NUMERIC UNDERSCORE MINUS BACKSPACE DELETE>;
    shift-list = <ALPHA>;
};

/* Custom behaviors/combos/layers */

ZMK_COMBO(copy, &kp LG(C), LM2 LB2, 0, 50)

MAKE_HRMS(homes, "balanced",
    hold-trigger-on-release;  // wait for other home row mods
    tapping-term-ms = <270>;
    quick-tap-ms = <300>;
    require-prior-idle-ms = <170>;
)
MAKE_HRMS(shift, "tap-preferred",
    tapping-term-ms = <170>;
    quick-tap-ms = <300>;
    require-prior-idle-ms = <70>;
)

ZMK_BEHAVIOR(thumb, hold_tap,
    flavor = "balanced";
    bindings = <&mo>, <&kp>;
    tapping-term-ms = <200>;
    quick-tap-ms = <300>;
    // no typing streak
)

ZMK_BEHAVIOR(space, hold_tap,
    flavor = "balanced";
    bindings = <&mo>, <&kp>;
    tapping-term-ms = <170>;
    quick-tap-ms = <200>;
    // no typing streak
    retro-tap; // allow slow (hold-like) taps
)

// tap: sticky-shift | shift + tap/ double-tap: caps-word | hold: shift
ZMK_BEHAVIOR(smart_shft, mod_morph,
    bindings = <&sk LSHFT>, <&caps_word>;
    mods = <(MOD_LSFT)>;
)

// cmd+tab swapper, requires PR #1366
ZMK_BEHAVIOR(macswap, tri_state,
    bindings = <&kt LGUI>, <&kp TAB>, <&kt LGUI>;
    ignored-key-positions = <LM1 RM0 RM1 RM2 RM3>;
)

// alt+tab swapper, requires PR #1366
ZMK_BEHAVIOR(winswap, tri_state,
    bindings = <&kt LALT>, <&kp TAB>, <&kt LALT>;
    ignored-key-positions = <LM1 RM0 RM1 RM2 RM3>;
)

/* Standard Glove80 behaviors and macros */

// For the "layer" key, it'd nice to be able to use it as either a shift or a toggle.
// Configure it as a tap dance, so the first tap (or hold) is a &mo and the second tap is a &to
ZMK_BEHAVIOR(lower, tap_dance,
    bindings = <&mo 1>, <&to 1>;
    tapping-term-ms = <200>;
)

ZMK_BEHAVIOR(magic, hold_tap,
    flavor = "tap-preferred";
    bindings = <&mo>, <&rgb_ug_status_macro>;
    tapping-term-ms = <200>;
)

ZMK_BEHAVIOR(rgb_ug_status_macro, macro,
    bindings = <&rgb_ug RGB_STATUS>;
)

ZMK_BEHAVIOR(bt_sel, macro_one_param,
    bindings = <&out OUT_BLE>, <&macro_param_1to2>, <&bt BT_SEL MACRO_PLACEHOLDER>;
)

#define XXX  &none
#define ___  &trans

#define BASE    0
#define LOWER   1
#define SYMBOL  2
#define MOUSE   3
#define MAGIC   4

#define TO_MAGIC  &magic MAGIC 0
#define ONEPASSWD &kp LG(LS(SPACE))
#define SPOTLIGHT &kp LG(SPACE)
#define EMOJI     &kp LG(LC(SPACE))

GLV80_LAYER(Base,
// ╭───────────────┬────────────────────┬───────────────────┬───────────────────┬─────────────────────╮                     ╭─────────────────────┬───────────────────┬─────────────────────┬───────────────────────┬───────────╮
     &kp C_BRI_DN    &kp C_BRI_UP         &kp C_PREV          &kp C_PP            &kp C_NEXT                                  &kp C_MUTE            &kp C_VOL_DN        &kp C_VOL_UP          &kp F11                 &kp F12
// ├───────────────┼────────────────────┼───────────────────┼───────────────────┼─────────────────────┼────────╮   ╭────────┼─────────────────────┼───────────────────┼─────────────────────┼───────────────────────┼───────────┤
     &kp GRAVE       &kp N1               &kp N2              &kp N3              &kp N4                &kp N5       &kp N6   &kp N7                &kp N8              &kp N9                &kp N0                  &kp MINUS
// ├───────────────┼────────────────────┼───────────────────┼───────────────────┼─────────────────────┼────────┤   ├────────┼─────────────────────┼───────────────────┼─────────────────────┼───────────────────────┼───────────┤
     &kp TAB         &kp Q                &kp W               &kp E               &kp R                 &kp T        &kp Y    &kp U                 &kp I               &kp O                 &kp P                   &kp BSLH
// ├───────────────┼────────────────────┼───────────────────┼───────────────────┼─────────────────────┼────────┤   ├────────┼─────────────────────┼───────────────────┼─────────────────────┼───────────────────────┼───────────┤
     &mt LCTRL ESC   &hml_homes LCTRL A   &hml_homes LALT S   &hml_homes LGUI D   &hml_shift LSHIFT F   &kp G        &kp H    &hmr_shift RSHIFT J   &hmr_homes RGUI K   &hmr_homes LALT L     &hmr_homes RCTRL SEMI   &kp SQT
// ├───────────────┼────────────────────┼───────────────────┼───────────────────┼─────────────────────┼────────┤   ├────────┼─────────────────────┼───────────────────┼─────────────────────┼───────────────────────┼───────────┤
     &kp GRAVE       &kp Z                &kp X               &kp C               &kp V                 &kp B    ,   &kp N    &kp M                 &kp COMMA           &kp DOT               &kp FSLH                &kp EQUAL
// ├───────────────┼────────────────────┼───────────────────┼───────────────────┼─────────────────────┼────────╯   ╰────────┼─────────────────────┼───────────────────┼─────────────────────┼───────────────────────┼───────────┤
     TO_MAGIC        XXX                  XXX                 &kp LEFT            &kp RIGHT                      ,            &kp LPAR              &kp LBKT            &kp RBKT              &kp RPAR                XXX
// ╰───────────────┴────────────────────┴───────────────────┴───────────────────┴─────────────────────╯                     ╰─────────────────────┴───────────────────┴─────────────────────┴───────────────────────┴───────────╯
                                                                                                                 ,
//                                                           ╭────────────────┬──────────────────┬──────────╮         ╭───────────┬───────────────┬─────────────────────╮
                                                               &smart_shft      XXX                EMOJI                ONEPASSWD   SPOTLIGHT       &kp TAB
/*                                                           ├────────────────┼──────────────────┼──────────┤ */ , /* ├───────────┼───────────────┼─────────────────────┤ */
                                                               &kp BACKSPACE    &thumb LOWER ESC   XXX                  &to MOUSE   &kp RET         &space SYMBOL SPACE
//                                                           ╰────────────────┴──────────────────┴──────────╯         ╰───────────┴───────────────┴─────────────────────╯
)

GLV80_LAYER(Lower,
// ╭──────────┬───────────┬──────────┬──────────┬────────────╮                            ╭──────────┬────────┬───────────┬────────┬─────────╮
     &kp F1     &kp F2      &kp F3     &kp F4     &kp F5                                    &kp F6     &kp F7   &kp F8      &kp F9   &kp F10
// ├──────────┼───────────┼──────────┼──────────┼────────────┼─────────────╮   ╭──────────┼──────────┼────────┼───────────┼────────┼─────────┤
     ___        ___         ___        ___        ___          ___               ___        ___        ___      ___         ___      ___
// ├──────────┼───────────┼──────────┼──────────┼────────────┼─────────────┤   ├──────────┼──────────┼────────┼───────────┼────────┼─────────┤
     ___        ___         ___        ___        ___          ___               ___        ___        ___      ___         ___      ___
// ├──────────┼───────────┼──────────┼──────────┼────────────┼─────────────┤   ├──────────┼──────────┼────────┼───────────┼────────┼─────────┤
     ___        ___         ___        ___        &kp LSHIFT   ___               &kp LEFT   &kp DOWN   &kp UP   &kp RIGHT   ___      ___
// ├──────────┼───────────┼──────────┼──────────┼────────────┼─────────────┤   ├──────────┼──────────┼────────┼───────────┼────────┼─────────┤
     ___        ___         &winswap   &macswap   ___          ___           ,   ___        ___        ___      ___         ___      ___
// ├──────────┼───────────┼──────────┼──────────┼────────────┼─────────────╯   ╰──────────┼──────────┼────────┼───────────┼────────┼─────────┤
     ___        ___         ___        ___        ___                        ,              ___        ___      ___         ___      ___
// ╰──────────┴───────────┴──────────┴──────────┴────────────╯                            ╰──────────┴────────┴───────────┴────────┴─────────╯
                                                                             ,
//                                           ╭────────┬────────┬────────╮         ╭────────┬─────────┬─────────╮
                                               ___      ___      ___                ___      ___       ___
/*                                           ├────────┼────────┼────────┤ */ , /* ├────────┼─────────┼─────────┤ */
                                               ___      XXX      ___                ___      ___       &kp DEL
//                                           ╰────────┴────────┴────────╯         ╰────────┴─────────┴─────────╯
)

GLV80_LAYER(Symbol,
// ╭────────────┬────────────┬────────────┬────────────┬────────────╮                             ╭────────────┬─────────────┬────────────┬────────────┬────────────╮
     XXX          XXX          XXX          XXX          XXX                                        XXX          XXX           XXX          XXX          XXX
// ├────────────┼────────────┼────────────┼────────────┼────────────┼────────────╮   ╭────────────┼────────────┼─────────────┼────────────┼────────────┼────────────┤
     XXX          &kp GRAVE    &kp LPAR     &kp RPAR     &kp SEMI     &kp COMMA        XXX          XXX          XXX           XXX          XXX          XXX
// ├────────────┼────────────┼────────────┼────────────┼────────────┼────────────┤   ├────────────┼────────────┼─────────────┼────────────┼────────────┼────────────┤
     &kp EXCL     &kp LBRC     &kp SQT      &kp DQT      &kp RBRC     &kp QMARK        XXX          &kp RSHIFT   &kp RGUI      &kp LALT     &kp RCTRL    XXX
// ├────────────┼────────────┼────────────┼────────────┼────────────┼────────────┤   ├────────────┼────────────┼─────────────┼────────────┼────────────┼────────────┤
     &kp HASH     &kp CARET    &kp EQUAL    &kp UNDER    &kp DLLR     &kp STAR         XXX          &kp BSPC     &kp TAB       &kp SPACE    &kp ENTER    XXX
// ├────────────┼────────────┼────────────┼────────────┼────────────┼────────────┤   ├────────────┼────────────┼─────────────┼────────────┼────────────┼────────────┤
     &kp AT       &kp LT       &kp PIPE     &kp MINUS    &kp GT       &kp FSLH     ,   XXX          &kp DEL      &kp LS(TAB)   XXX          XXX          XXX
// ├────────────┼────────────┼────────────┼────────────┼────────────┼────────────╯   ╰────────────┼────────────┼─────────────┼────────────┼────────────┼────────────┤
     &kp TILDE    &kp AMPS     &kp LBKT     &kp RBKT     &kp PLUS                  ,                XXX          XXX           XXX          XXX          XXX
// ╰────────────┴────────────┴────────────┴────────────┴────────────╯                             ╰────────────┴─────────────┴────────────┴────────────┴────────────╯
                                                                                   ,
//                                   ╭────────────┬────────────┬──────────────╮         ╭────────────┬────────────┬────────────╮
                                       &kp BSLH     &kp DOT      &kp STAR                 XXX          XXX          XXX
/*                                   ├────────────┼────────────┼──────────────┤ */ , /* ├────────────┼────────────┼────────────┤ */
                                       &kp PRCNT    &kp COLON    &kp SEMI                 XXX          XXX          XXX
//                                   ╰────────────┴────────────┴──────────────╯         ╰────────────┴────────────┴────────────╯
)

GLV80_LAYER(Mouse,
// ╭────────┬───────────┬──────────┬──────────┬────────────╮                     ╭────────────────┬────────────────┬─────────────────┬────────┬────────╮
     XXX      XXX         XXX        XXX        XXX                                XXX              XXX              XXX               XXX      XXX
// ├────────┼───────────┼──────────┼──────────┼────────────┼────────╮   ╭────────┼────────────────┼────────────────┼─────────────────┼────────┼────────┤
     XXX      XXX         XXX        XXX        XXX          XXX          XXX      XXX              XXX              XXX               XXX      XXX
// ├────────┼───────────┼──────────┼──────────┼────────────┼────────┤   ├────────┼────────────────┼────────────────┼─────────────────┼────────┼────────┤
     XXX      XXX         &kp RALT   XXX        XXX          XXX          XXX      XXX              &mmv MOVE_UP     &msc SCRL_DOWN    XXX      XXX
// ├────────┼───────────┼──────────┼──────────┼────────────┼────────┤   ├────────┼────────────────┼────────────────┼─────────────────┼────────┼────────┤
     XXX      &kp LCTRL   &kp LALT   &kp LGUI   &kp LSHIFT   XXX          XXX      &mmv MOVE_LEFT   &mmv MOVE_DOWN   &mmv MOVE_RIGHT   XXX      XXX
// ├────────┼───────────┼──────────┼──────────┼────────────┼────────┤   ├────────┼────────────────┼────────────────┼─────────────────┼────────┼────────┤
     XXX      XXX         XXX        XXX        XXX          XXX      ,   XXX      XXX              XXX              &msc SCRL_UP      XXX      XXX
// ├────────┼───────────┼──────────┼──────────┼────────────┼────────╯   ╰────────┼────────────────┼────────────────┼─────────────────┼────────┼────────┤
     XXX      XXX         XXX        XXX        XXX                   ,            XXX              XXX              XXX               XXX      XXX
// ╰────────┴───────────┴──────────┴──────────┴────────────╯                     ╰────────────────┴────────────────┴─────────────────┴────────┴────────╯
                                                                      ,
//                                    ╭────────┬────────┬────────╮         ╭──────────┬──────────┬──────────╮
                                        XXX      XXX      XXX                XXX        XXX        XXX
/*                                    ├────────┼────────┼────────┤ */ , /* ├──────────┼──────────┼──────────┤ */
                                        XXX      XXX      XXX                &to BASE   &mkp MB2   &mkp MB1
//                                    ╰────────┴────────┴────────╯         ╰──────────┴──────────┴──────────╯
)

GLV80_LAYER(Magic,
// ╭─────────────┬─────────────────┬─────────────────┬─────────────────┬─────────────────╮                             ╭───────┬───────┬───────┬───────┬────────────────╮
     &bt BT_CLR    XXX               XXX               XXX               XXX                                             XXX     XXX     XXX     XXX     &bt BT_CLR_ALL
// ├─────────────┼─────────────────┼─────────────────┼─────────────────┼─────────────────┼─────────────────╮   ╭───────┼───────┼───────┼───────┼───────┼────────────────┤
     XXX           XXX               XXX               XXX               XXX               XXX                   XXX     XXX     XXX     XXX     XXX     XXX
// ├─────────────┼─────────────────┼─────────────────┼─────────────────┼─────────────────┼─────────────────┤   ├───────┼───────┼───────┼───────┼───────┼────────────────┤
     XXX           &rgb_ug RGB_SPI   &rgb_ug RGB_SAI   &rgb_ug RGB_HUI   &rgb_ug RGB_BRI   &rgb_ug RGB_TOG       XXX     XXX     XXX     XXX     XXX     XXX
// ├─────────────┼─────────────────┼─────────────────┼─────────────────┼─────────────────┼─────────────────┤   ├───────┼───────┼───────┼───────┼───────┼────────────────┤
     &bootloader   &rgb_ug RGB_SPD   &rgb_ug RGB_SAD   &rgb_ug RGB_HUD   &rgb_ug RGB_BRD   &rgb_ug RGB_EFF       XXX     XXX     XXX     XXX     XXX     &bootloader
// ├─────────────┼─────────────────┼─────────────────┼─────────────────┼─────────────────┼─────────────────┤   ├───────┼───────┼───────┼───────┼───────┼────────────────┤
     &sys_reset    XXX               XXX               XXX               XXX               XXX               ,   XXX     XXX     XXX     XXX     XXX     &sys_reset
// ├─────────────┼─────────────────┼─────────────────┼─────────────────┼─────────────────┼─────────────────╯   ╰───────┼───────┼───────┼───────┼───────┼────────────────┤
     XXX           XXX               XXX               XXX               XXX                                 ,           XXX     XXX     XXX     XXX     XXX
// ╰─────────────┴─────────────────┴─────────────────┴─────────────────┴─────────────────╯                             ╰───────┴───────┴───────┴───────┴────────────────╯
                                                                                                             ,
//                                                               ╭───────────┬───────────┬──────────────╮         ╭───────┬───────┬───────╮
                                                                   &bt_sel 2   &bt_sel 3   XXX                      XXX     XXX     XXX
/*                                                               ├───────────┼───────────┼──────────────┤ */ , /* ├───────┼───────┼───────┤ */
                                                                   &bt_sel 0   &bt_sel 1   &out OUT_USB             XXX     XXX     XXX
//                                                               ╰───────────┴───────────┴──────────────╯         ╰───────┴───────┴───────╯
)
